## west.yml
```yaml
manifest:
  remotes:
    - name: zephyr-upstream
      url-base: https://github.com/zephyrproject-rtos
    - name: comstack
      url-base: git@bitbucket.org:peter_toenz/comstack.git

  projects:
    - name: zephyr
      remote: zephyr-upstream
      revision: v4.3.0
      import:
        name-allowlist:
          - cmsis_6
          - hal_stm32
    - name: comstack
      remote: comstack
      revision: master


  self:
    path: zephyr-firmware
```
